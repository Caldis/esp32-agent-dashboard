/*
 * ota_verify.c — orchestrates header parse, hash, and ed25519
 *                verify for the dashboard's signed OTA flow.
 *
 * See ota_verify.h for the contract and the deviation note about
 * mbedtls/ed25519.h. The actual ed25519 verify lives in
 * ed25519_verify.c (verify-only, portable C, public-domain
 * ref10-derivative).
 *
 * ## Why
 *
 * We hash the *concatenation* of (magic || version_le || size_le ||
 * firmware) rather than just the firmware bytes. The header fields
 * are short but security-relevant: an attacker who could lift a
 * signature off one payload and paste it onto a firmware blob of a
 * different size, or with a different declared version, would
 * trivially break us if those fields weren't signed. So they are.
 *
 * We read firmware bytes back out of flash (rather than keeping them
 * in RAM) for the hash step because a typical payload is 2-4 MB and
 * the S3 only has ~512 KB of internal RAM; PSRAM would work but the
 * partition is already there, and the SHA-512 HW peripheral
 * processes flash-resident data fine.
 */

#include "ota_verify.h"
#include "ota_pubkey.h"      /* generated by tools/sign/generate_keys.py */

#include <stdio.h>
#include <string.h>

#include "esp_log.h"
#include "esp_partition.h"

#include "mbedtls/sha512.h"
#include "mbedtls/sha256.h"

/* Verify-only ed25519. Declared here to avoid leaking a header that
 * a caller might confuse with a real ed25519 sign API. */
extern int ed25519_verify_detached(const uint8_t signature[64],
                                   const uint8_t *message,
                                   size_t message_len,
                                   const uint8_t public_key[32]);

static const char *TAG = "ota_verify";

/* ── Header parse ─────────────────────────────────────────────────── */

ota_verify_result_t ota_verify_parse_header(const uint8_t *buf,
                                            size_t buf_len,
                                            uint32_t max_firmware_size,
                                            ota_header_t *out)
{
    if (!buf || !out || buf_len < OTA_VERIFY_HEADER_LEN) {
        return OTA_VERIFY_ERR_SIZE;
    }
    if (memcmp(buf, OTA_VERIFY_MAGIC, OTA_VERIFY_MAGIC_LEN) != 0) {
        return OTA_VERIFY_ERR_MAGIC;
    }
    uint16_t ver  = (uint16_t)buf[4] | ((uint16_t)buf[5] << 8);
    uint32_t size = (uint32_t)buf[6]
                  | ((uint32_t)buf[7] << 8)
                  | ((uint32_t)buf[8] << 16)
                  | ((uint32_t)buf[9] << 24);
    if (size == 0 || size > max_firmware_size) {
        return OTA_VERIFY_ERR_SIZE;
    }
    out->version = ver;
    out->size    = size;
    memcpy(out->sig, buf + 10, OTA_VERIFY_SIG_LEN);
    return OTA_VERIFY_OK;
}

/* ── Version policy ───────────────────────────────────────────────── */

ota_verify_result_t ota_verify_check_version(uint16_t candidate, uint16_t running)
{
    if (candidate <= running) return OTA_VERIFY_ERR_VERSION;
    uint16_t cand_major = (candidate >> 12) & 0xF;
    uint16_t run_major  = (running   >> 12) & 0xF;
    if (cand_major > run_major + 1) return OTA_VERIFY_ERR_MAJOR_SKIP;
    return OTA_VERIFY_OK;
}

uint16_t ota_verify_encode_semver(const char *semver)
{
    if (!semver) return 0;
    unsigned a = 0, b = 0, c = 0;
    /* Tolerant parser: accepts "vX.Y.Z" and "X.Y.Z". Anything not
     * matching that produces 0 (unknown). */
    if (semver[0] == 'v' || semver[0] == 'V') semver++;
    if (sscanf(semver, "%u.%u.%u", &a, &b, &c) < 1) return 0;
    if (a > 15 || b > 63 || c > 63) return 0;
    return (uint16_t)((a << 12) | (b << 6) | c);
}

/* ── SHA-512 over header-prefix + flash-resident firmware ─────────── */

#define HASH_CHUNK 4096

static int hash_header_and_firmware(const esp_partition_t *slot,
                                    const ota_header_t *hdr,
                                    uint8_t out_hash[64])
{
    mbedtls_sha512_context ctx;
    mbedtls_sha512_init(&ctx);
    int rc = mbedtls_sha512_starts(&ctx, 0 /* = SHA-512 (not 384) */);
    if (rc != 0) goto done;

    /* magic */
    rc = mbedtls_sha512_update(&ctx, (const uint8_t *)OTA_VERIFY_MAGIC,
                               OTA_VERIFY_MAGIC_LEN);
    if (rc != 0) goto done;

    /* version (LE) */
    uint8_t ver_le[2] = {
        (uint8_t)(hdr->version & 0xFF),
        (uint8_t)((hdr->version >> 8) & 0xFF),
    };
    rc = mbedtls_sha512_update(&ctx, ver_le, sizeof(ver_le));
    if (rc != 0) goto done;

    /* size (LE) */
    uint8_t size_le[4] = {
        (uint8_t)( hdr->size        & 0xFF),
        (uint8_t)((hdr->size >>  8) & 0xFF),
        (uint8_t)((hdr->size >> 16) & 0xFF),
        (uint8_t)((hdr->size >> 24) & 0xFF),
    };
    rc = mbedtls_sha512_update(&ctx, size_le, sizeof(size_le));
    if (rc != 0) goto done;

    /* firmware — streamed in chunks from the slot, starting AFTER
     * the 74-byte header that was streamed in. */
    static uint8_t chunk[HASH_CHUNK];
    uint32_t remaining = hdr->size;
    size_t   offset    = OTA_VERIFY_HEADER_LEN;
    while (remaining > 0) {
        size_t want = remaining > HASH_CHUNK ? HASH_CHUNK : remaining;
        esp_err_t err = esp_partition_read(slot, offset, chunk, want);
        if (err != ESP_OK) {
            ESP_LOGE(TAG, "esp_partition_read @%u: 0x%x",
                     (unsigned)offset, err);
            rc = -1;
            goto done;
        }
        rc = mbedtls_sha512_update(&ctx, chunk, want);
        if (rc != 0) goto done;
        remaining -= want;
        offset    += want;
    }

    rc = mbedtls_sha512_finish(&ctx, out_hash);
done:
    mbedtls_sha512_free(&ctx);
    return rc;
}

/* ── Full verify ──────────────────────────────────────────────────── */

ota_verify_result_t ota_verify_payload_partition(const esp_partition_t *slot,
                                                 const ota_header_t *hdr)
{
    if (!slot || !hdr) return OTA_VERIFY_ERR_INTERNAL;

    /* ed25519 sign/verify uses raw message bytes (not pre-hashed)
     * per RFC 8032. The library does its own internal SHA-512 over
     * R || A || message. So we pass the *concatenation*, not the
     * pre-computed hash, to ed25519_verify_detached.
     *
     * For large messages we hand it a streaming-friendly buffer.
     * But ed25519's internal hash needs to walk the message twice
     * (once for `H(R || A || M)`), which means we can't simply
     * stream-and-forget. The portable ed25519 implementation we
     * bundle takes a *contiguous* message buffer; to avoid loading
     * 4 MB of firmware into RAM we'd need a streaming verify
     * variant. That's a v0.6.1 perf task. For v0.6.0 we sidestep
     * the buffer-size problem by:
     *
     *   - computing sha512(magic || ver || size || firmware)
     *     ourselves (streaming, HW-accelerated)
     *   - asking ed25519 to verify the signature over those 64
     *     hash bytes
     *
     * This means the SIGNER MUST also produce the signature over
     * the same 64-byte hash, not over the raw message. We document
     * this in sign_firmware.py — the signed message is the SHA-512
     * digest. The crypto is still RFC 8032 ed25519, just with the
     * application-layer choice to sign a pre-hash of long data
     * (a.k.a. ed25519ph-style, but using our own prefix scheme).
     */
    uint8_t digest[64];
    if (hash_header_and_firmware(slot, hdr, digest) != 0) {
        return OTA_VERIFY_ERR_READ;
    }

    int ok = ed25519_verify_detached(hdr->sig, digest, sizeof(digest),
                                     ota_pubkey);
    if (!ok) {
        ESP_LOGW(TAG, "ed25519 signature verification FAILED");
        return OTA_VERIFY_ERR_SIGNATURE;
    }
    ESP_LOGI(TAG, "ed25519 signature OK (version=0x%04x size=%u)",
             hdr->version, (unsigned)hdr->size);
    return OTA_VERIFY_OK;
}

/* ── Reason stringifier ───────────────────────────────────────────── */

const char *ota_verify_reason_str(ota_verify_result_t r)
{
    switch (r) {
    case OTA_VERIFY_OK:             return "ok";
    case OTA_VERIFY_ERR_MAGIC:      return "magic";
    case OTA_VERIFY_ERR_SIZE:       return "size";
    case OTA_VERIFY_ERR_VERSION:    return "version";
    case OTA_VERIFY_ERR_MAJOR_SKIP: return "major_skip";
    case OTA_VERIFY_ERR_SIGNATURE:  return "signature";
    case OTA_VERIFY_ERR_READ:       return "read";
    case OTA_VERIFY_ERR_INTERNAL:   return "internal";
    default:                        return "unknown";
    }
}

/* ── Pubkey fingerprint ───────────────────────────────────────────── */

void ota_verify_pubkey_fingerprint(char out[17])
{
    uint8_t h[32];
    mbedtls_sha256(ota_pubkey, OTA_VERIFY_PUBKEY_LEN, h, 0);
    static const char hex[] = "0123456789abcdef";
    for (int i = 0; i < 8; i++) {
        out[2 * i]     = hex[(h[i] >> 4) & 0xF];
        out[2 * i + 1] = hex[ h[i]       & 0xF];
    }
    out[16] = '\0';
}
